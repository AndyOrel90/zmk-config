#include <behaviors.dtsi>
#include <dt-bindings/zmk/keys.h>
#include <dt-bindings/zmk/bt.h>
#include <dt-bindings/zmk/outputs.h>
//#include <dt-bindings/zmk/mouse.h>

// Left/Right
#define ARDUX_LEFT 1

// ARTS Row
#define KEY_A 0 //N
#define KEY_R 1 //E
#define KEY_T 2 //I
#define KEY_S 3 //O
// EYIO Row
#define KEY_E 4 //A
#define KEY_Y 5 //R
#define KEY_I 6 //S
#define KEY_O 7 //T

// Define Offsets
#define LEADING_NONES NONE(0,0,0)
#define MIDDLE_NONES NONE(0, 0, 0)
#define TRAILING_NONES NONE(0, 0, 0)

#define ARDUX_LAYER_CUSTOM                                                   \
		custom {                                                              \
			label = "Custom";                                                 \
			bindings = <                                                      \
				LEADING_NONES                                                 \
				&mo LAYER_ID_CUSTOM  &kp LC(A)  &kp LC(Z)   &kp LC(C) \
				MIDDLE_NONES                                                  \
				&none   &kp LC(X)  &kp LC(Y)   &kp LC(V) \
				TRAILING_NONES                                                \
			>;                                                                \
		};

// Include main ardux.io keymap
#include "../../../ardux.dtsi"